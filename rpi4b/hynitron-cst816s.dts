/dts-v1/;
/plugin/;

/ {
    fragment@0 {
        target = <&i2c1>;
        __overlay__ {
            cst816s: cst816s@15 {
                compatible = "hynitron,cst816s";
                reg = <0x15>;
                interrupt-parent = <&gpio>;
                interrupts = <4 1>; /* IRQF_TRIGGER_RISING */
                reset-gpios = <&gpio 17 1>; /* GPIO_ACTIVE_LOW */
                linux,keycodes = <0x14a>,  // BTN_TOUCH
                    <0x67>,   // KEY_UP
                    <0x6c>,   // KEY_DOWN
                    <0x69>,   // KEY_LEFT
                    <0x6a>,   // KEY_RIGHT
                    <0x00>,   // KEY_RESERVED
                    <0x00>,   // KEY_RESERVED
                    <0x00>,   // KEY_RESERVED
                    <0x00>,   // KEY_RESERVED
                    <0x00>,   // KEY_RESERVED
                    <0x00>,   // KEY_RESERVED
                    <0x00>,   // KEY_RESERVED
                    <0x14e>;  // BTN_TOOL_TRIPLETAP
            };
        };
    };
};
