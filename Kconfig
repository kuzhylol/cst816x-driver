## Kconfig
```kconfig
config TOUCHSCREEN_HYNITRON_CST816X
	tristate "Hynitron CST816x series touchscreen"
	depends on I2C
	help
	  Say Y here if you have a touchscreen using a Hynitron
	  CST816x series touchscreen controller.

	  If unsure, say N.

	  To compile this driver as a module, choose M here: the
	  module will be called hynitron-cst816x.
```
